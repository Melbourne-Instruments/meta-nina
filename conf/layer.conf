## conf/layer.conf
```bitbake
BBPATH .= ":${LAYERDIR}"

BBFILES += "\
    ${LAYERDIR}/recipes-*/*/*.bb \
    ${LAYERDIR}/recipes-*/*/*.bbappend \
"

BBFILE_PATTERN_elk = "^${LAYERDIR}/"
BBFILE_PRIORITY_elk = "8"
LAYERDEPENDS = "qt5"
LAYERSERIES_COMPAT_elk = "dunfell hardknott"
LAYERDEPENDS_meta-scipy = "core openembedded-layer meta-python"
```
